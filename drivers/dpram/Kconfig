## drivers/dpram/Kconfig
```kconfig
# Dpram configuration
#

#     TelephonyFeature.CHINA_CTC_DATA [
#     Add this file
#     ]

menu "Dpram support"

config DPRAM
       tristate "Using smem as dpram"
       default y
       ---help---
		Include this for using smem as dpram for communication between modem and appl.
endmenu
```
